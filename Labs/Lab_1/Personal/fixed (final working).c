// filename ******** fixed.c ************** 
// possible header file for Lab 1 Spring 2017
// feel free to change the specific syntax of your system
// Tarang Khandpur - Karime Saad
// 9/5/17

//imports
#include <stdio.h>
#include <stdint.h>
#include "string.h"
#include "ST7735.h"
#include "PLL.h"
#include "fixed.h"
#include "inc/tm4c123gh6pm.h"

const uint16_t Logo[] = {
 0xFFFF, 0xFFFF, 0xFFFF, 0xFFFF, 0xFFFF, 0xFFFF, 0xFFFF, 0xFFFF, 0xFFFF, 0xFFFF, 0xFFFF, 0xFFFF, 0xFFFF, 0xFFFF, 0xFFFF, 0xFFFF,
 0xFFFF, 0xFFFF, 0xFFFF, 0xFFFF, 0xFFFF, 0xFFFF, 0xFFFF, 0xFFFF, 0xFFFF, 0xFFFF, 0xFFFF, 0xFFFF, 0xFFFF, 0xFFFF, 0xFFFF, 0xFFFF,
 0xFFFF, 0xFFFF, 0xFFFF, 0xFFFF, 0xFFFF, 0xFFFF, 0xFFFF, 0xFFFF, 0xFFFF, 0xFFFF, 0xFFFF, 0xFFFF, 0xFFFF, 0xFFFF, 0xFFFF, 0xFFFF,
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 0xFFFF, 0xFFFF, 0xFFFF, 0xFFFF, 0xFFFF, 0xFFFF, 0xFFFF, 0xFFFF, 0xFFFF, 0xFFFF, 0xFFFF, 0xFFFF, 0xFFFF, 0xFFFF, 0xFFFF, 0xFFFF
};

//Global Variables
		int32_t screenWidth = 128;
		int32_t screenHeight = 160;
		int32_t maxXPlot = 128; //correponds to the maximum possible right x-axis point on the coordinate plot
		int32_t minXPlot = 0; //correponds to the minimum possible left x-axis point on the coordinate plot
		int32_t maxYPlot = 32; //correponds to the maximum possible right y-axis point on the coordinate plot
		int32_t minYPlot = 160; //correponds to the minimum possible left y-axis point on the coordinate plot
		int32_t xOffset;
		int32_t yOffset;
		int32_t xScale;
		int32_t yScale;
		int32_t xPlot = 0;
		int32_t yPlot = 32;

/****************Name: ST7735_sDecOut3***************
 Author: Karime Saad, Tarang Khandpur
 Description: converts fixed point number to LCD
              format signed 32-bit with resolution 0.001
              range -9.999 to +9.999
 Inputs:  signed 32-bit integer part of fixed-point number
 Outputs: Prints exactly a 6 character fixed point number to LCD 
          Parameter LCD display
 12345    " *.***"
  2345    " 2.345"  digs[5,4,3,2]
 -8100    "-8.100"
  -102    "-0.102" 
    31    " 0.031" 
-12345    " *.***"
 */

void ST7735_sDecOut3(int32_t n){
	int digs[4] = {0,0,0,0};
	int count = 0;
	if ((n <= 9999) && (n >= -9999)) { //checks to see if number is in valid range
		if (n >= 0){
			ST7735_OutChar(' '); //outputs a space if input is positive
		}
		else {
			ST7735_OutChar('-'); //outputs a "-" if input is negative
			n = n * (-1); //converts the negative to positive
		}
		while (n > 0){
			digs[count] = n%10; //gets lowest value digit ex: 123, digs[0] = 3, digs[1] = 2, digs[2] = 1
			n = n / 10; //removes lowest value digit, ex: 123 -> 12, 12 -> 1, 1 -> 0
			count++;
		}
		count = 3; // 
		while (count >= 0){
			ST7735_OutChar(digs[count] + '0'); //+0 is to get the correct ascii code for a digit. This also prints the last number in the dig[].
			if (count == 3){
				ST7735_OutChar('.'); //prints the '.' after the first digit is output
			}
			count--;
		}
	}
	else {
		ST7735_OutChar(' ');
		ST7735_OutChar('*');
		ST7735_OutChar('.');
		ST7735_OutChar('*');
		ST7735_OutChar('*');
		ST7735_OutChar('*');
	}
}

/**************Name: ST7735_uBinOut8***************
 Author: Karime Saad, Tarang Khandpur 
Description: unsigned 32-bit binary fixed-point with a resolution of 1/256. 
             The full-scale range is from 0 to 999.99. 
             If the integer part is larger than 256000, it signifies an error. 
             The ST7735_uBinOut8 function takes an unsigned 32-bit integer part 
             of the binary fixed-point number and outputs the fixed-point value on the LCD
 Inputs:  unsigned 32-bit integer part of binary fixed-point number
 Outputs: Prints exactly a 6 character fixed point number to LCD 
Parameter LCD display
     0	  "  0.00"
     2	  "  0.01"
    64	  "  0.25"
   100	  "  0.39"
   500	  "  1.95"
   512	  "  2.00"
  5000	  " 19.53"
 30000	  "117.19"
255997	  "999.99"
256000	  "***.**"
*/

void ST7735_uBinOut8(uint32_t n){

	char outArray[6] = {'*','*','*','.','*','*'};
	int resolution = 8; //log(256)/log(2) ~~ log(resolution)/log(binary)
	uint32_t fractionalPart = 0;
	uint32_t intPart = 0;
	int count = 0;
	int bitValue = 0;

	if (n < 256000) {
		while (count < resolution){ //8 is used to isolate the rightmost 8 bits
			bitValue = (n & (1 << count));
			if (bitValue > 0){
				// in worst case we could have all bits as 1
				// then we need to add all the 1/2^m the position of that 1 to the right of binary decimal
				// thus there could be additions of 8 fractions
				// we could lose precision if we just consider 2 digits for each
				// so 1/ 2^1 = 0.5
				// so 1/ 2^2 = 0.25
				// so 1/ 2^3 = 0.125
				// so 1/ 2^4 = 0.0625
				// so 1/ 2^5 = 0.03125
				// so 1/ 2^6 = 0.015625
				// so 1/ 2^7 = 0.0078125
				// so 1/ 2^8 = 0.00390625
				// assume value is 1111 1111 which should be 255/256 = 0.99609 - correct answer should be 0.99
				// rounding - if we consider 2 digits to the right of decimal then sum is .5 + .25 + .12 + .06 + .03 + .01 = 1
				// rounding - if we consider 3 digits to the right of decimal then sum is .5 + .25 + .12 + .06 + .03 + .01 = .997
				// but integer division truncates
				// trunc - if we consider 2 digits to the right of decimal then sum is .5 + .25 + .12 + .06 + .03 + .01 = 0.97
				// trunc - if we consider 3 digits to the right of decimal then sum is .5 + .25 + .12 + .06 + .03 + .01 = .993
				
				// so we should multiply by 1009 to get 3 digits to the right of decimal and then drop off 1 digit
				fractionalPart = fractionalPart + (1000/(1 << (8 - count))); 
			}
			count++;
		}
// alt. 2 start
//	float	temp = 100.0 * n / 256 ; //multiply by 100 to get the 2 decimal digits. use .0 so that the results is in float with decimal precision
// 	fractionalPart = temp ; // will drop the unrequired digits after 5 digits.
// alt. 2 end

		fractionalPart = fractionalPart / 10; //drop the non-required digit
		outArray[5] = (fractionalPart % 10) + '0'; //get the least significant digit
		fractionalPart = fractionalPart / 10;
		outArray[4] = (fractionalPart % 10) + '0'; //get the next least significant digit
		outArray[3] = '.';
		intPart = (n >> 8);	// drop the last 2 digits which were part of the precision (right of decimal point)
		outArray[2] = (intPart % 10) + '0'; // get the unit digit
		intPart = intPart / 10;
		if (intPart > 0){
			outArray[1] = (intPart % 10) + '0'; //get the hundered digit
		}
		else {
			outArray[1] = ' ';
		}
		intPart = intPart / 10;
		if (intPart > 0){
			outArray[0] = (intPart % 10) + '0'; //get the thousand's digit
		}
		else {
			outArray[0] = ' ';
		}
	}
	ST7735_OutString(outArray);
}; 

/**************Name: ST7735_XYplotInit***************
 Author: Karime Saad, Tarang Khandpur
 Description: Specify the X and Y axes for an x-y scatter plot
              Draw the title and clear the plot area
 Inputs:  title  ASCII string to label the plot, null-termination
          minX   smallest X data value allowed, resolution= 0.001
          maxX   largest X data value allowed, resolution= 0.001
          minY   smallest Y data value allowed, resolution= 0.001
          maxY   largest Y data value allowed, resolution= 0.001
 Outputs: Prints the Title for the shape to be drawn, and Sets the plot area to white background.
          assumes minX < maxX, and miny < maxY
*/

/*
void ST7735_XYplotInit(char *title, int32_t minX, int32_t maxX, int32_t minY, int32_t maxY){
	ST7735_FillScreen(ST7735_BLACK); 
	
	//Draws Title
	ST7735_SetCursor(0,0);
	while(*title != NULL){
		printf("%c", *title);
		title++;
	}
	
	//Creates White Plot Area
	for (int16_t i = 0; i < 127; i++){
		for (int16_t j = 32; j < 159; j++){
			ST7735_DrawPixel(i,j,ST7735_WHITE);
		}
	}
}

*/


void ST7735_XYplotInit(char *title, int32_t minX, int32_t maxX, int32_t minY, int32_t maxY){
    ST7735_FillScreen(ST7735_BLACK); 
		
		//create title area
		ST7735_FillRect(0, 0, screenWidth, maxYPlot, ST7735_BLACK);
		ST7735_SetCursor(1,1);
//	ST7735_OutString(title);
	
		//create plot area
		ST7735_FillRect(0, maxYPlot, maxXPlot - minXPlot, (maxYPlot - minYPlot) * -1, ST7735_WHITE); //muly by -1 because y is reversed
		
		//scale input
		xScale = (10000 * (maxX - minX)) /(maxXPlot - minXPlot); // use 10000 to retain a resolution of 0.001 - digit extra to account loss of precision . may or may not be requuired
		yScale = (10000 * (maxY - minY)) /(maxYPlot - minYPlot);

		//offset		
		xOffset = maxXPlot - (10000 * maxX / xScale);
		yOffset = maxYPlot - (10000 * maxY / yScale);

};


/**************Name: ST7735_XYplot***************
 Author: Karime Saad, Tarang Khandpur
 Description: Plot an array of (x,y) data
 Inputs:  num    number of data points in the two arrays
          bufX   array of 32-bit fixed-point data, resolution= 0.001
          bufY   array of 32-bit fixed-point data, resolution= 0.001
 Outputs: Draws shape to cleared plot area
          assumes ST7735_XYplotInit has been previously called
          neglect any points outside the minX maxY minY maxY bounds
*/

/*
void ST7735_XYplot(uint32_t num, int32_t bufX[], int32_t bufY[]){
	int16_t xCoor = 0;
	int16_t yCoor = 0;
	
	if(num == 180){ //Determines Object to be Drawn is a circle
			for (int16_t i = 0; i < num; i++){
			
				xCoor = bufX[i]/50 + 60;
			
				yCoor = bufY[i]/50 +100;
				ST7735_DrawPixel(xCoor,yCoor,ST7735_BLACK);
			}
	} else {
			for (int16_t i = 0; i < num; i++){
			
				xCoor = (bufX[i]*2)/7 + 80;
			
				yCoor = bufY[i]*2/7 + 80;
				ST7735_DrawPixel(xCoor,yCoor,ST7735_BLACK);
			}
			
	}
}

*/

void ST7735_XYplot(uint32_t numPoints, int32_t bufX[], int32_t bufY[]){
	for (int i = 0; i < numPoints; i++){	
		ST7735_DrawPixel((10000 * bufX[i]/xScale + xOffset),(10000 * bufY[i]/yScale + yOffset),ST7735_BLUE);
		}
};

void TitleScreen(char *labTitle, char *labDesc, char *st1FN, char *st1LN, char *st2FN, char *st2LN){
	ST7735_FillScreen(ST7735_WHITE);
	
	//Create Title Area
	ST7735_FillRect(0, 0, screenWidth, (screenHeight/3), ST7735_BLACK);
	ST7735_SetCursor(1,1);
	ST7735_DrawString(1,2, labTitle, ST7735_WHITE);
	ST7735_DrawString(2,3, labDesc, ST7735_WHITE);
	
	//Students Names	
		//uint32_t ST7735_DrawString(uint16_t x, uint16_t y, char *pt, int16_t textColor){
	ST7735_DrawString(1,6, st1FN, ST7735_BLACK);
	ST7735_DrawString(2,7, st1LN, ST7735_BLACK);
	ST7735_DrawString(1,9, st2FN, ST7735_BLACK);
	ST7735_DrawString(2,10, st2LN, ST7735_BLACK);
	
	//UT Logo Code
    ST7735_DrawBitmap(88, 160, Logo, 40, 160);
}

