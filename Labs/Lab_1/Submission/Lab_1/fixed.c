/********* fixed.c **************
 Author: Tarang Khandpur, Karime Saad
 Description: C file for Lab 1 Fall 2017
 Date: September 10, 2017
*********************************/

//imports
#include <stdio.h>
#include <stdint.h>
#include "string.h"
#include "ST7735.h"
#include "PLL.h"
#include "fixed.h"
#include "inc/tm4c123gh6pm.h"

const uint16_t Logo[] = {
 0xFFFF, 0xFFFF, 0xFFFF, 0xFFFF, 0xFFFF, 0xFFFF, 0xFFFF, 0xFFFF, 0xFFFF, 0xFFFF, 0xFFFF, 0xFFFF, 0xFFFF, 0xFFFF, 0xFFFF, 0xFFFF,
 0xFFFF, 0xFFFF, 0xFFFF, 0xFFFF, 0xFFFF, 0xFFFF, 0xFFFF, 0xFFFF, 0xFFFF, 0xFFFF, 0xFFFF, 0xFFFF, 0xFFFF, 0xFFFF, 0xFFFF, 0xFFFF,
 0xFFFF, 0xFFFF, 0xFFFF, 0xFFFF, 0xFFFF, 0xFFFF, 0xFFFF, 0xFFFF, 0xFFFF, 0xFFFF, 0xFFFF, 0xFFFF, 0xFFFF, 0xFFFF, 0xFFFF, 0xFFFF,
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 0xFFFF, 0xFFFF, 0xFFFF, 0xFFFF, 0xFFFF, 0xFFFF, 0xFFFF, 0xFFFF, 0xFFFF, 0xFFFF, 0xFFFF, 0xFFFF, 0xFFFF, 0xFFFF, 0xFFFF, 0xFFFF
};

//Global Variables
		int32_t screenWidth = 128;
		int32_t screenHeight = 160;

		int32_t plotMaxX = 128; //correponds to the maximum possible right x-axis point on the coordinate plot
		int32_t plotMinX = 0; //correponds to the minimum possible left x-axis point on the coordinate plot
		int32_t plotMaxY = 32; //correponds to the maximum possible right y-axis point on the coordinate plot
		int32_t plotMinY = 160; //correponds to the minimum possible left y-axis point on the coordinate plot
	
		int32_t xOffset;
		int32_t yOffset;
		int32_t xScale;
		int32_t yScale;
		int32_t xPlot = 0;
		int32_t yPlot = 32;

/****************Name: ST7735_sDecOut3***************
 Author: Karime Saad, Tarang Khandpur
 Description: converts fixed point number to LCD
              format signed 32-bit with resolution 0.001
              range -9.999 to +9.999
 Inputs:  signed 32-bit integer part of fixed-point number
 Outputs: Prints exactly a 6 character fixed point number to LCD 
          Parameter LCD display
 12345    " *.***"
  2345    " 2.345"  digs[5,4,3,2]
 -8100    "-8.100"
  -102    "-0.102" 
    31    " 0.031" 
-12345    " *.***"
 */

void ST7735_sDecOut3(int32_t n){
	int digs[4] = {0,0,0,0};
	int count = 0;
	if ((n <= 9999) && (n >= -9999)) {
		if (n >= 0){
			ST7735_OutChar(' ');
		}
		else {
			ST7735_OutChar('-');
			n = n * (-1);
		}
		//gets lowest value digit ex: 123, digs[0] = 3, digs[1] = 2, digs[2] = 1
		//removes lowest value digit, ex: 123 -> 12, 12 -> 1, 1 -> 0
		while (n > 0){
			digs[count] = n%10;
			n = n / 10; 
			count++;
		}
		
		//print the answer to screen in appropriate order
		count = 3; 
		while (count >= 0){
			ST7735_OutChar(digs[count] + '0'); //+0 is to get the correct ascii code for a digit. This also prints the last number in the dig[].
			if (count == 3){
				ST7735_OutChar('.'); 
			}
			count--;
		}
	}
	else {
		ST7735_OutChar(' ');
		ST7735_OutChar('*');
		ST7735_OutChar('.');
		ST7735_OutChar('*');
		ST7735_OutChar('*');
		ST7735_OutChar('*');
	}
}

/**************Name: ST7735_uBinOut8***************
 Author: Karime Saad, Tarang Khandpur 
Description: unsigned 32-bit binary fixed-point with a resolution of 1/256. 
             The full-scale range is from 0 to 999.99. 
             If the integer part is larger than 256000, it signifies an error. 
             The ST7735_uBinOut8 function takes an unsigned 32-bit integer part 
             of the binary fixed-point number and outputs the fixed-point value on the LCD
 Inputs:  unsigned 32-bit integer part of binary fixed-point number
 Outputs: Prints exactly a 6 character fixed point number to LCD 
Parameter LCD display
     0	  "  0.00"
     2	  "  0.01"
    64	  "  0.25"
   100	  "  0.39"
   500	  "  1.95"
   512	  "  2.00"
  5000	  " 19.53"
 30000	  "117.19"
255997	  "999.99"
256000	  "***.**"
*/

void ST7735_uBinOut8(uint32_t n){

	char outArray[6] = {' ',' ',' ','.',' ',' '};
	int resolution = 8; //log(256)/log(2) ~~ log(resolution)/log(binary)
	uint32_t fractionalPart = 0;
	uint32_t intPart = 0;
	int count = 0;
	int bitValue = 0;

	if (n < 256000) {
		while (count < resolution){ //8 is used to isolate the rightmost 8 bits
			bitValue = (n & (1 << count));
			if (bitValue > 0){
				fractionalPart = fractionalPart + (1000/(1 << (8 - count))); 
			}
			count++;
		}

		fractionalPart = fractionalPart / 10;
		outArray[5] = (fractionalPart % 10) + '0';
		fractionalPart = fractionalPart / 10;
		outArray[4] = (fractionalPart % 10) + '0';
		outArray[3] = '.';
		intPart = (n >> resolution);
		outArray[2] = (intPart % 10) + '0';
		intPart = intPart / 10;
		if (intPart > 0){
			outArray[1] = (intPart % 10) + '0';
		}
		intPart = intPart / 10;
		if (intPart > 0){
			outArray[0] = (intPart % 10) + '0';
		}
	} 
	else {
		 for (int i = 0; i < 6; i++){
				outArray[i] = '*';
		 }
		 outArray[3] = '.';
	}
	ST7735_OutString(outArray);
}; 

/**************Name: ST7735_XYplotInit***************
 Author: Karime Saad, Tarang Khandpur
 Description: Specify the X and Y axes for an x-y scatter plot
              Draw the title and clear the plot area
 Inputs:  title  ASCII string to label the plot, null-termination
          minX   smallest X data value allowed, resolution= 0.001
          maxX   largest X data value allowed, resolution= 0.001
          minY   smallest Y data value allowed, resolution= 0.001
          maxY   largest Y data value allowed, resolution= 0.001
 Outputs: Prints the Title for the shape to be drawn, and Sets the plot area to white background.
          assumes minX < maxX, and miny < maxY
*/

void ST7735_XYplotInit(char *title, int32_t minX, int32_t maxX, int32_t minY, int32_t maxY){
    int32_t plotWidth = plotMaxX-plotMinX;
		int32_t plotHeight = plotMinY-plotMaxY;
	
		ST7735_FillScreen(ST7735_BLACK); 
		
		//create title area
		ST7735_FillRect(0, 0, screenWidth, (screenHeight-plotHeight), ST7735_BLACK);
		ST7735_SetCursor(1,1);
		ST7735_OutString(title);
	
		//create plot area
		ST7735_FillRect(plotMinX, plotMaxY, plotWidth, plotHeight, ST7735_WHITE);
		
		//scale input - mulitplied by 1000 since resolution is .001
		xScale = 1000*((maxX - minX)/(plotWidth));
		yScale = 1000*((maxY - minY)/(plotHeight*(-1)));
		
		//offset - used to find center of screen
		xOffset = plotMaxX - ((1000*maxX)/xScale); //maxX is mulitplied by 1000 to counter the resolution in xScale
		yOffset = plotMaxY - ((1000*maxY)/yScale);
};


/**************Name: ST7735_XYplot***************
 Author: Karime Saad, Tarang Khandpur
 Description: Plot an array of (x,y) data
 Inputs:  numPoints    number of data points in the two arrays
          bufX   array of 32-bit fixed-point data, resolution= 0.001
          bufY   array of 32-bit fixed-point data, resolution= 0.001
 Outputs: Draws shape to cleared plot area
          assumes ST7735_XYplotInit has been previously called
          neglect any points outside the minX maxY minY maxY bounds
*/

void ST7735_XYplot(uint32_t numPoints, int32_t bufX[], int32_t bufY[]){
	for (int i = 0; i < numPoints; i++){
		ST7735_DrawPixel((1000*bufX[i]/xScale + xOffset),(1000*bufY[i]/yScale + yOffset),ST7735_BLUE);
		}
};

/*************Name: TitleScreen ******************
 Author: Karime Saad, Tarang Khandpur
 Description: Prints the title of the Lab, along with a short desciption
				      and the names of the students involved.
Inputs: labTitle    title of the Lab/lab number
				labDesc      one line desc. of the lab
        st1FN       Student 1 First Name
				st1LN       Student 1 Last Name
				st2FN       Student 2 First Name
				st2LN       Student 2 Last Name
*/
void TitleScreen(char *labTitle, char *labDesc, char *st1FN, char *st1LN, char *st2FN, char *st2LN){
	ST7735_FillScreen(ST7735_WHITE);
	
	//Create Title Area
	ST7735_FillRect(0, 0, screenWidth, (screenHeight/3), ST7735_BLACK);
	ST7735_SetCursor(1,1);
	ST7735_DrawString(1,2, labTitle, ST7735_WHITE);
	ST7735_DrawString(2,3, labDesc, ST7735_WHITE);
	
	//Students Names	
	ST7735_DrawString(1,6, st1FN, ST7735_BLACK);
	ST7735_DrawString(2,7, st1LN, ST7735_BLACK);
	ST7735_DrawString(1,9, st2FN, ST7735_BLACK);
	ST7735_DrawString(2,10, st2LN, ST7735_BLACK);
	
	//UT Logo Code
  ST7735_DrawBitmap(88, 160, Logo, 40, 160);
}